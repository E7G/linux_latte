## arch/x86/configs/xiaomipad2_defconfig
```kconfig
CONFIG_KERNEL_ZSTD=yCONFIG_DEFAULT_HOSTNAME="mipad2"CONFIG_SYSVIPC=yCONFIG_POSIX_MQUEUE=yCONFIG_WATCH_QUEUE=yCONFIG_USELIB=yCONFIG_NO_HZ=yCONFIG_HIGH_RES_TIMERS=yCONFIG_BPF_SYSCALL=yCONFIG_BPF_JIT=yCONFIG_BPF_JIT_ALWAYS_ON=yCONFIG_BPF_LSM=yCONFIG_SCHED_CORE=yCONFIG_BSD_PROCESS_ACCT=yCONFIG_BSD_PROCESS_ACCT_V3=yCONFIG_TASKSTATS=yCONFIG_TASK_DELAY_ACCT=yCONFIG_TASK_XACCT=yCONFIG_TASK_IO_ACCOUNTING=yCONFIG_PSI=yCONFIG_IKCONFIG=yCONFIG_IKCONFIG_PROC=yCONFIG_LOG_BUF_SHIFT=21CONFIG_UCLAMP_TASK=yCONFIG_MEMCG=yCONFIG_BLK_CGROUP=yCONFIG_CFS_BANDWIDTH=yCONFIG_UCLAMP_TASK_GROUP=yCONFIG_CGROUP_PIDS=yCONFIG_CGROUP_RDMA=yCONFIG_CGROUP_FREEZER=yCONFIG_CGROUP_HUGETLB=yCONFIG_CPUSETS=yCONFIG_CGROUP_DEVICE=yCONFIG_CGROUP_CPUACCT=yCONFIG_CGROUP_PERF=yCONFIG_CGROUP_BPF=yCONFIG_CGROUP_MISC=yCONFIG_NAMESPACES=yCONFIG_USER_NS=yCONFIG_CHECKPOINT_RESTORE=y# CONFIG_RD_BZIP2 is not set# CONFIG_RD_LZO is not setCONFIG_EXPERT=yCONFIG_PC104=yCONFIG_KALLSYMS_ALL=yCONFIG_PROFILING=yCONFIG_KEXEC=yCONFIG_KEXEC_FILE=yCONFIG_KEXEC_SIG=yCONFIG_KEXEC_BZIMAGE_VERIFY_SIG=yCONFIG_KEXEC_JUMP=yCONFIG_SMP=yCONFIG_X86_X2APIC=yCONFIG_X86_CPU_RESCTRL=yCONFIG_X86_INTEL_LPSS=yCONFIG_X86_AMD_PLATFORM_DEVICE=yCONFIG_IOSF_MBI_DEBUG=yCONFIG_PROCESSOR_SELECT=y# CONFIG_CPU_SUP_AMD is not set# CONFIG_CPU_SUP_HYGON is not set# CONFIG_CPU_SUP_CENTAUR is not set# CONFIG_CPU_SUP_ZHAOXIN is not setCONFIG_MAXSMP=yCONFIG_X86_REROUTE_FOR_BROKEN_BOOT_IRQS=yCONFIG_X86_MCELOG_LEGACY=y# CONFIG_PERF_EVENTS_INTEL_RAPL is not setCONFIG_ARCH_MEMORY_PROBE=yCONFIG_X86_PMEM_LEGACY=yCONFIG_X86_CHECK_BIOS_CORRUPTION=yCONFIG_MTRR_SANITIZER_ENABLE_DEFAULT=1# CONFIG_X86_KERNEL_IBT is not setCONFIG_X86_SGX=yCONFIG_EFI=yCONFIG_EFI_STUB=yCONFIG_EFI_MIXED=yCONFIG_LIVEPATCH=y# CONFIG_CPU_MITIGATIONS is not setCONFIG_HIBERNATION=yCONFIG_PM_WAKELOCKS=yCONFIG_PM_DEBUG=yCONFIG_PM_ADVANCED_DEBUG=yCONFIG_PM_TRACE_RTC=yCONFIG_WQ_POWER_EFFICIENT_DEFAULT=yCONFIG_ENERGY_MODEL=yCONFIG_ACPI_DEBUGGER=yCONFIG_ACPI_DEBUGGER_USER=yCONFIG_ACPI_FPDT=yCONFIG_ACPI_DOCK=yCONFIG_ACPI_PROCESSOR_AGGREGATOR=yCONFIG_ACPI_PCI_SLOT=yCONFIG_ACPI_HOTPLUG_MEMORY=yCONFIG_ACPI_BGRT=yCONFIG_ACPI_APEI=yCONFIG_ACPI_APEI_GHES=yCONFIG_ACPI_APEI_PCIEAER=yCONFIG_ACPI_APEI_MEMORY_FAILURE=yCONFIG_ACPI_DPTF=yCONFIG_DPTF_POWER=y# CONFIG_DPTF_PCH_FIVR is not setCONFIG_PMIC_OPREGION=yCONFIG_BYTCRC_PMIC_OPREGION=yCONFIG_CHTCRC_PMIC_OPREGION=yCONFIG_BXT_WC_PMIC_OPREGION=yCONFIG_CHT_WC_PMIC_OPREGION=yCONFIG_CPU_FREQ_STAT=yCONFIG_CPU_FREQ_GOV_POWERSAVE=yCONFIG_CPU_FREQ_GOV_USERSPACE=yCONFIG_CPU_FREQ_GOV_ONDEMAND=yCONFIG_CPU_FREQ_GOV_CONSERVATIVE=yCONFIG_X86_PCC_CPUFREQ=yCONFIG_X86_AMD_PSTATE=yCONFIG_X86_ACPI_CPUFREQ=yCONFIG_X86_POWERNOW_K8=yCONFIG_X86_SPEEDSTEP_CENTRINO=yCONFIG_CPU_IDLE_GOV_LADDER=yCONFIG_CPU_IDLE_GOV_MENU=yCONFIG_CPU_IDLE_GOV_TEO=yCONFIG_INTEL_IDLE=yCONFIG_ISA_BUS=y# CONFIG_VIRTUALIZATION is not setCONFIG_JUMP_LABEL=yCONFIG_COMPAT_32BIT_TIME=yCONFIG_RANDOMIZE_KSTACK_OFFSET_DEFAULT=yCONFIG_MODULES=yCONFIG_MODULE_UNLOAD=yCONFIG_MODVERSIONS=yCONFIG_MODULE_SRCVERSION_ALL=yCONFIG_BLK_DEV_BSGLIB=yCONFIG_BLK_DEV_INTEGRITY=yCONFIG_BLK_DEV_ZONED=yCONFIG_BLK_DEV_THROTTLING=yCONFIG_BLK_WBT=yCONFIG_BLK_CGROUP_IOCOST=yCONFIG_BLK_CGROUP_IOPRIO=yCONFIG_BLK_SED_OPAL=yCONFIG_BLK_INLINE_ENCRYPTION=yCONFIG_BLK_INLINE_ENCRYPTION_FALLBACK=yCONFIG_PARTITION_ADVANCED=yCONFIG_BSD_DISKLABEL=yCONFIG_MINIX_SUBPARTITION=yCONFIG_SOLARIS_X86_PARTITION=yCONFIG_UNIXWARE_DISKLABEL=yCONFIG_LDM_PARTITION=yCONFIG_SGI_PARTITION=yCONFIG_CMDLINE_PARTITION=y# CONFIG_MQ_IOSCHED_KYBER is not setCONFIG_ZSWAP=yCONFIG_ZSWAP_ZPOOL_DEFAULT_ZBUD=yCONFIG_SLAB_FREELIST_RANDOM=yCONFIG_SLAB_FREELIST_HARDENED=yCONFIG_SHUFFLE_PAGE_ALLOCATOR=y# CONFIG_COMPAT_BRK is not setCONFIG_MEMORY_HOTPLUG=yCONFIG_MEMORY_HOTREMOVE=yCONFIG_PAGE_REPORTING=yCONFIG_KSM=yCONFIG_DEFAULT_MMAP_MIN_ADDR=65536CONFIG_MEMORY_FAILURE=yCONFIG_MEM_SOFT_DIRTY=yCONFIG_IDLE_PAGE_TRACKING=yCONFIG_ZONE_DEVICE=yCONFIG_DEVICE_PRIVATE=yCONFIG_ANON_VMA_NAME=yCONFIG_USERFAULTFD=yCONFIG_NET=yCONFIG_PACKET=yCONFIG_UNIX=yCONFIG_TLS=yCONFIG_TLS_DEVICE=yCONFIG_XDP_SOCKETS=yCONFIG_INET=yCONFIG_IP_MULTICAST=yCONFIG_IP_ADVANCED_ROUTER=yCONFIG_IP_FIB_TRIE_STATS=yCONFIG_IP_MULTIPLE_TABLES=yCONFIG_IP_ROUTE_MULTIPATH=yCONFIG_IP_ROUTE_VERBOSE=yCONFIG_IP_MROUTE=yCONFIG_IP_MROUTE_MULTIPLE_TABLES=yCONFIG_IP_PIMSM_V1=yCONFIG_IP_PIMSM_V2=yCONFIG_SYN_COOKIES=y# CONFIG_INET_DIAG is not setCONFIG_TCP_CONG_ADVANCED=y# CONFIG_TCP_CONG_BIC is not set# CONFIG_TCP_CONG_WESTWOOD is not set# CONFIG_TCP_CONG_HTCP is not setCONFIG_TCP_MD5SIG=yCONFIG_IPV6_ROUTER_PREF=yCONFIG_IPV6_ROUTE_INFO=y# CONFIG_IPV6_SIT is not setCONFIG_IPV6_SUBTREES=yCONFIG_IPV6_MROUTE=yCONFIG_IPV6_MROUTE_MULTIPLE_TABLES=yCONFIG_IPV6_PIMSM_V2=yCONFIG_IPV6_SEG6_LWTUNNEL=yCONFIG_IPV6_SEG6_HMAC=yCONFIG_IPV6_IOAM6_LWTUNNEL=yCONFIG_MPTCP=yCONFIG_NETWORK_PHY_TIMESTAMPING=yCONFIG_NETFILTER=yCONFIG_NF_CONNTRACK=yCONFIG_NF_CONNTRACK_MARK=yCONFIG_NF_CONNTRACK_SECMARK=yCONFIG_NF_CONNTRACK_ZONES=yCONFIG_NF_CONNTRACK_EVENTS=yCONFIG_NF_CONNTRACK_TIMEOUT=yCONFIG_NF_CONNTRACK_TIMESTAMP=yCONFIG_NF_CONNTRACK_LABELS=yCONFIG_NF_NAT=yCONFIG_NF_TABLES=yCONFIG_NF_TABLES_INET=yCONFIG_NF_TABLES_NETDEV=yCONFIG_NFT_CT=yCONFIG_NFT_REJECT=yCONFIG_NETFILTER_XTABLES=yCONFIG_NF_TABLES_ARP=yCONFIG_IP6_NF_IPTABLES=mCONFIG_IP6_NF_NAT=mCONFIG_IP6_NF_TARGET_MASQUERADE=mCONFIG_BRIDGE=yCONFIG_NET_SCHED=yCONFIG_NET_EMATCH=yCONFIG_NET_CLS_ACT=yCONFIG_NET_TC_SKB_EXT=yCONFIG_DCB=yCONFIG_DNS_RESOLVER=yCONFIG_MPLS=yCONFIG_NET_SWITCHDEV=yCONFIG_QRTR=yCONFIG_NET_NCSI=yCONFIG_NCSI_OEM_CMD_GET_MAC=yCONFIG_CGROUP_NET_PRIO=yCONFIG_CGROUP_NET_CLASSID=yCONFIG_BPF_STREAM_PARSER=yCONFIG_NET_DROP_MONITOR=yCONFIG_HAMRADIO=yCONFIG_BT=yCONFIG_BT_RFCOMM=yCONFIG_BT_RFCOMM_TTY=yCONFIG_BT_BNEP=yCONFIG_BT_BNEP_MC_FILTER=yCONFIG_BT_BNEP_PROTO_FILTER=yCONFIG_BT_LEDS=yCONFIG_BT_MSFTEXT=yCONFIG_BT_AOSPEXT=yCONFIG_BT_HCIUART=mCONFIG_BT_HCIUART_BCSP=yCONFIG_BT_HCIUART_ATH3K=yCONFIG_BT_HCIUART_LL=yCONFIG_BT_HCIUART_BCM=yCONFIG_BT_HCIUART_RTL=yCONFIG_BT_BCM=mCONFIG_MCTP=yCONFIG_CFG80211=mCONFIG_CFG80211_DEBUGFS=yCONFIG_CFG80211_WEXT=yCONFIG_RFKILL=yCONFIG_RFKILL_INPUT=yCONFIG_PCI=yCONFIG_PCIEPORTBUS=yCONFIG_HOTPLUG_PCI_PCIE=yCONFIG_PCIEAER=yCONFIG_PCIE_DPC=yCONFIG_PCIE_PTM=yCONFIG_PCIE_EDR=yCONFIG_PCI_MSI=yCONFIG_PCI_REALLOC_ENABLE_AUTO=yCONFIG_PCI_IOV=yCONFIG_HOTPLUG_PCI=yCONFIG_HOTPLUG_PCI_ACPI=yCONFIG_HOTPLUG_PCI_CPCI=yCONFIG_HOTPLUG_PCI_SHPC=yCONFIG_PCIE_DW_PLAT_HOST=yCONFIG_PCIE_DW_PLAT_EP=yCONFIG_PCI_ENDPOINT=yCONFIG_PCI_ENDPOINT_CONFIGFS=yCONFIG_UEVENT_HELPER=yCONFIG_DEVTMPFS=yCONFIG_DEVTMPFS_MOUNT=yCONFIG_DEVTMPFS_SAFE=y# CONFIG_STANDALONE is not setCONFIG_FW_LOADER_USER_HELPER=yCONFIG_FW_LOADER_COMPRESS=yCONFIG_FW_LOADER_COMPRESS_ZSTD=yCONFIG_FW_UPLOAD=yCONFIG_CONNECTOR=yCONFIG_EDD=yCONFIG_EDD_OFF=yCONFIG_APPLE_PROPERTIES=yCONFIG_RESET_ATTACK_MITIGATION=yCONFIG_EFI_RCI2_TABLE=yCONFIG_EFI_COCO_SECRET=y# CONFIG_PNP_DEBUG_MESSAGES is not setCONFIG_BLK_DEV_LOOP=yCONFIG_SRAM=yCONFIG_INTEL_MEI_TXE=yCONFIG_INTEL_MEI_HDCP=yCONFIG_INTEL_MEI_PXP=yCONFIG_PVPANIC=yCONFIG_BLK_DEV_SD=yCONFIG_BLK_DEV_SR=yCONFIG_CHR_DEV_SG=yCONFIG_SCSI_CONSTANTS=yCONFIG_SCSI_LOGGING=yCONFIG_SCSI_SCAN_ASYNC=yCONFIG_MEGARAID_NEWGEN=yCONFIG_SCSI_DH=yCONFIG_ATA=yCONFIG_SATA_ZPODD=yCONFIG_ATA_PIIX=yCONFIG_PATA_SIS=yCONFIG_ATA_GENERIC=yCONFIG_MD=yCONFIG_BLK_DEV_MD=yCONFIG_BLK_DEV_DM=yCONFIG_DM_MULTIPATH=yCONFIG_DM_INIT=yCONFIG_DM_UEVENT=yCONFIG_DM_AUDIT=yCONFIG_MACINTOSH_DRIVERS=yCONFIG_MAC_EMUMOUSEBTN=yCONFIG_NETDEVICES=yCONFIG_NET_FC=yCONFIG_MACVLAN=yCONFIG_MACVTAP=yCONFIG_IPVLAN=yCONFIG_IPVTAP=yCONFIG_TUN=yCONFIG_VETH=mCONFIG_NETKIT=y# CONFIG_NET_VENDOR_3COM is not set# CONFIG_NET_VENDOR_ADAPTEC is not set# CONFIG_NET_VENDOR_AGERE is not set# CONFIG_NET_VENDOR_ALACRITECH is not set# CONFIG_NET_VENDOR_ALTEON is not set# CONFIG_NET_VENDOR_AMAZON is not set# CONFIG_NET_VENDOR_AMD is not set# CONFIG_NET_VENDOR_AQUANTIA is not set# CONFIG_NET_VENDOR_ARC is not set# CONFIG_NET_VENDOR_ASIX is not set# CONFIG_NET_VENDOR_ATHEROS is not set# CONFIG_NET_VENDOR_CADENCE is not set# CONFIG_NET_VENDOR_CAVIUM is not set# CONFIG_NET_VENDOR_CHELSIO is not set# CONFIG_NET_VENDOR_CISCO is not set# CONFIG_NET_VENDOR_CORTINA is not set# CONFIG_NET_VENDOR_DAVICOM is not set# CONFIG_NET_VENDOR_DEC is not set# CONFIG_NET_VENDOR_DLINK is not set# CONFIG_NET_VENDOR_EMULEX is not set# CONFIG_NET_VENDOR_ENGLEDER is not set# CONFIG_NET_VENDOR_EZCHIP is not set# CONFIG_NET_VENDOR_FUNGIBLE is not set# CONFIG_NET_VENDOR_GOOGLE is not set# CONFIG_NET_VENDOR_HUAWEI is not set# CONFIG_NET_VENDOR_ADI is not set# CONFIG_NET_VENDOR_LITEX is not set# CONFIG_NET_VENDOR_MARVELL is not set# CONFIG_NET_VENDOR_MELLANOX is not set# CONFIG_NET_VENDOR_META is not set# CONFIG_NET_VENDOR_MICREL is not set# CONFIG_NET_VENDOR_MICROCHIP is not set# CONFIG_NET_VENDOR_MICROSEMI is not set# CONFIG_NET_VENDOR_MICROSOFT is not set# CONFIG_NET_VENDOR_MYRI is not set# CONFIG_NET_VENDOR_NI is not set# CONFIG_NET_VENDOR_NATSEMI is not set# CONFIG_NET_VENDOR_NETERION is not set# CONFIG_NET_VENDOR_NETRONOME is not set# CONFIG_NET_VENDOR_NVIDIA is not set# CONFIG_NET_VENDOR_OKI is not set# CONFIG_NET_VENDOR_PACKET_ENGINES is not set# CONFIG_NET_VENDOR_PENSANDO is not set# CONFIG_NET_VENDOR_QLOGIC is not set# CONFIG_NET_VENDOR_BROCADE is not set# CONFIG_NET_VENDOR_QUALCOMM is not set# CONFIG_NET_VENDOR_RDC is not setCONFIG_R8169=y# CONFIG_NET_VENDOR_RENESAS is not set# CONFIG_NET_VENDOR_ROCKER is not set# CONFIG_NET_VENDOR_SAMSUNG is not set# CONFIG_NET_VENDOR_SEEQ is not set# CONFIG_NET_VENDOR_SILAN is not set# CONFIG_NET_VENDOR_SIS is not set# CONFIG_NET_VENDOR_SOLARFLARE is not set# CONFIG_NET_VENDOR_SMSC is not set# CONFIG_NET_VENDOR_SOCIONEXT is not set# CONFIG_NET_VENDOR_STMICRO is not set# CONFIG_NET_VENDOR_SUN is not set# CONFIG_NET_VENDOR_SYNOPSYS is not set# CONFIG_NET_VENDOR_TEHUTI is not set# CONFIG_NET_VENDOR_TI is not set# CONFIG_NET_VENDOR_VERTEXCOM is not set# CONFIG_NET_VENDOR_VIA is not set# CONFIG_NET_VENDOR_WANGXUN is not set# CONFIG_NET_VENDOR_WIZNET is not set# CONFIG_NET_VENDOR_XILINX is not setCONFIG_LED_TRIGGER_PHY=yCONFIG_BCM84881_PHY=yCONFIG_PSE_CONTROLLER=yCONFIG_PPP=yCONFIG_PPP_FILTER=yCONFIG_PPP_MULTILINK=y# CONFIG_USB_NET_DRIVERS is not set# CONFIG_WLAN_VENDOR_ADMTEK is not set# CONFIG_WLAN_VENDOR_ATH is not set# CONFIG_WLAN_VENDOR_ATMEL is not setCONFIG_BRCMFMAC=mCONFIG_BRCMFMAC_USB=yCONFIG_BRCMFMAC_PCIE=yCONFIG_BRCM_TRACING=y# CONFIG_WLAN_VENDOR_INTEL is not set# CONFIG_WLAN_VENDOR_INTERSIL is not set# CONFIG_WLAN_VENDOR_MARVELL is not set# CONFIG_WLAN_VENDOR_MEDIATEK is not set# CONFIG_WLAN_VENDOR_MICROCHIP is not set# CONFIG_WLAN_VENDOR_PURELIFI is not set# CONFIG_WLAN_VENDOR_RALINK is not set# CONFIG_WLAN_VENDOR_REALTEK is not set# CONFIG_WLAN_VENDOR_RSI is not set# CONFIG_WLAN_VENDOR_SILABS is not set# CONFIG_WLAN_VENDOR_ST is not set# CONFIG_WLAN_VENDOR_TI is not set# CONFIG_WLAN_VENDOR_ZYDAS is not set# CONFIG_WLAN_VENDOR_QUANTENNA is not setCONFIG_WWAN=yCONFIG_INPUT_MOUSEDEV=yCONFIG_INPUT_MOUSEDEV_PSAUX=yCONFIG_INPUT_JOYDEV=yCONFIG_INPUT_EVDEV=yCONFIG_KEYBOARD_GPIO=y# CONFIG_MOUSE_PS2 is not setCONFIG_INPUT_JOYSTICK=yCONFIG_INPUT_TABLET=yCONFIG_INPUT_TOUCHSCREEN=y# CONFIG_TOUCHSCREEN_DA9034 is not setCONFIG_INPUT_MISC=yCONFIG_INPUT_PCSPKR=yCONFIG_INPUT_UINPUT=yCONFIG_INPUT_SOC_BUTTON_ARRAY=y# CONFIG_SERIO_SERPORT is not setCONFIG_LEGACY_PTY_COUNT=0CONFIG_SERIAL_8250=y# CONFIG_SERIAL_8250_DEPRECATED_OPTIONS is not setCONFIG_SERIAL_8250_16550A_VARIANTS=yCONFIG_SERIAL_8250_FINTEK=yCONFIG_SERIAL_8250_CONSOLE=y# CONFIG_SERIAL_8250_EXAR is not setCONFIG_SERIAL_8250_NR_UARTS=48CONFIG_SERIAL_8250_RUNTIME_UARTS=32CONFIG_SERIAL_8250_EXTENDED=yCONFIG_SERIAL_8250_MANY_PORTS=yCONFIG_SERIAL_8250_SHARE_IRQ=yCONFIG_SERIAL_8250_RSA=yCONFIG_SERIAL_8250_DW=yCONFIG_SERIAL_8250_RT288X=y# CONFIG_SERIAL_8250_LPSS is not set# CONFIG_SERIAL_8250_MID is not set# CONFIG_SERIAL_8250_PERICOM is not setCONFIG_SERIAL_KGDB_NMI=yCONFIG_SERIAL_MAX310X=yCONFIG_SERIAL_SCCNXP=yCONFIG_SERIAL_SCCNXP_CONSOLE=yCONFIG_SERIAL_NONSTANDARD=yCONFIG_SERIAL_DEV_BUS=yCONFIG_TTY_PRINTK=yCONFIG_VIRTIO_CONSOLE=yCONFIG_HW_RANDOM=y# CONFIG_HW_RANDOM_INTEL is not set# CONFIG_HW_RANDOM_AMD is not set# CONFIG_HW_RANDOM_VIA is not setCONFIG_HPET=yCONFIG_I2C_CHARDEV=yCONFIG_I2C_CHT_WC=yCONFIG_I2C_DESIGNWARE_CORE=yCONFIG_I2C_DESIGNWARE_BAYTRAIL=yCONFIG_SPI=yCONFIG_SPI_MEM=yCONFIG_SPI_INTEL_PLATFORM=yCONFIG_SPI_SLAVE=yCONFIG_PINCTRL_CHERRYVIEW=yCONFIG_GPIO_SYSFS=yCONFIG_GPIO_GENERIC_PLATFORM=yCONFIG_GPIO_CRYSTAL_COVE=yCONFIG_GPIO_PALMAS=yCONFIG_GPIO_RC5T583=yCONFIG_GPIO_TPS6586X=yCONFIG_GPIO_TPS65910=yCONFIG_POWER_RESET=yCONFIG_BATTERY_BQ27XXX=yCONFIG_CHARGER_MANAGER=yCONFIG_CHARGER_BQ25890=yCONFIG_SENSORS_CORETEMP=yCONFIG_THERMAL_STATISTICS=yCONFIG_THERMAL_GOV_FAIR_SHARE=yCONFIG_THERMAL_GOV_BANG_BANG=yCONFIG_THERMAL_GOV_POWER_ALLOCATOR=yCONFIG_DEVFREQ_THERMAL=yCONFIG_THERMAL_EMULATION=yCONFIG_INTEL_POWERCLAMP=y`r`nCONFIG_INTEL_SOC_DTS_THERMAL=yCONFIG_X86_PKG_TEMP_THERMAL=yCONFIG_INT340X_THERMAL=yCONFIG_INT3406_THERMAL=yCONFIG_INTEL_HFI_THERMAL=yCONFIG_WATCHDOG=yCONFIG_WATCHDOG_SYSFS=yCONFIG_WATCHDOG_PRETIMEOUT_GOV=y# CONFIG_WATCHDOG_PRETIMEOUT_GOV_PANIC is not setCONFIG_WDAT_WDT=yCONFIG_MFD_AS3711=yCONFIG_PMIC_ADP5520=yCONFIG_MFD_AAT2870_CORE=yCONFIG_PMIC_DA903X=yCONFIG_MFD_DA9052_SPI=yCONFIG_MFD_DA9052_I2C=yCONFIG_MFD_DA9055=yCONFIG_MFD_DA9063=yCONFIG_LPC_ICH=yCONFIG_INTEL_SOC_PMIC=yCONFIG_INTEL_SOC_PMIC_BXTWC=yCONFIG_INTEL_SOC_PMIC_CHTWC=yCONFIG_MFD_INTEL_PMC_BXT=yCONFIG_MFD_88PM860X=yCONFIG_MFD_MAX14577=yCONFIG_MFD_MAX77693=yCONFIG_MFD_MAX77843=yCONFIG_MFD_MAX8925=yCONFIG_MFD_MAX8997=yCONFIG_MFD_MAX8998=yCONFIG_EZX_PCAP=yCONFIG_MFD_RC5T583=yCONFIG_MFD_SYSCON=yCONFIG_MFD_LP8788=yCONFIG_MFD_PALMAS=yCONFIG_MFD_TPS65090=yCONFIG_MFD_TPS6586X=yCONFIG_MFD_TPS65910=yCONFIG_MFD_TPS65912_I2C=yCONFIG_MFD_TPS65912_SPI=yCONFIG_TWL4030_CORE=yCONFIG_MFD_TWL4030_AUDIO=yCONFIG_TWL6040_CORE=yCONFIG_MFD_WM8400=yCONFIG_MFD_WM831X_I2C=yCONFIG_MFD_WM831X_SPI=yCONFIG_MFD_WM8350_I2C=yCONFIG_REGULATOR=yCONFIG_RC_CORE=yCONFIG_LIRC=y# CONFIG_RC_MAP is not setCONFIG_RC_DECODERS=yCONFIG_RC_DEVICES=yCONFIG_MEDIA_CEC_SUPPORT=yCONFIG_MEDIA_SUPPORT=yCONFIG_MEDIA_SUPPORT_FILTER=yCONFIG_MEDIA_CAMERA_SUPPORT=yCONFIG_MEDIA_PLATFORM_SUPPORT=yCONFIG_MEDIA_TEST_SUPPORT=yCONFIG_MEDIA_USB_SUPPORT=yCONFIG_MEDIA_PCI_SUPPORT=yCONFIG_IPU_BRIDGE=yCONFIG_V4L_PLATFORM_DRIVERS=yCONFIG_V4L_TEST_DRIVERS=y# CONFIG_VIDEO_IR_I2C is not setCONFIG_VIDEO_OV5693=mCONFIG_VIDEO_T4KA3=mCONFIG_VIDEO_DW9719=mCONFIG_AUXDISPLAY=yCONFIG_AGP=yCONFIG_AGP_INTEL=yCONFIG_AGP_VIA=yCONFIG_VGA_SWITCHEROO=yCONFIG_DRM=yCONFIG_DRM_PANIC=yCONFIG_DRM_LOAD_EDID_FIRMWARE=yCONFIG_DRM_I915=yCONFIG_DRM_I915_PXP=yCONFIG_FB=yCONFIG_FB_ASILIANT=yCONFIG_FB_IMSTT=yCONFIG_FB_VESA=yCONFIG_FB_EFI=yCONFIG_FIRMWARE_EDID=yCONFIG_FB_MODE_HELPERS=yCONFIG_FB_TILEBLITTING=yCONFIG_BACKLIGHT_LP855X=yCONFIG_FRAMEBUFFER_CONSOLE_ROTATION=yCONFIG_FRAMEBUFFER_CONSOLE_DEFERRED_TAKEOVER=yCONFIG_SOUND=y# CONFIG_SOUND_OSS_CORE_PRECLAIM is not setCONFIG_SND=yCONFIG_SND_OSSEMUL=yCONFIG_SND_DYNAMIC_MINORS=y# CONFIG_SND_CTL_FAST_LOOKUP is not set# CONFIG_SND_PCI is not set# CONFIG_SND_SPI is not set# CONFIG_SND_USB is not setCONFIG_SND_SOC=yCONFIG_SND_SST_ATOM_HIFI2_PLATFORM_ACPI=mCONFIG_SND_SOC_INTEL_CHT_BSW_RT5659_MACH=mCONFIG_SND_SOC_TFA989X=y# CONFIG_SND_X86 is not setCONFIG_HID_BATTERY_STRENGTH=yCONFIG_HIDRAW=yCONFIG_UHID=yCONFIG_HID_MULTITOUCH=yCONFIG_HID_SENSOR_HUB=yCONFIG_HID_SENSOR_CUSTOM_SENSOR=yCONFIG_I2C_HID_ACPI=yCONFIG_I2C_HID_OF=yCONFIG_INTEL_ISH_HID=yCONFIG_HID_PID=yCONFIG_USB_HIDDEV=yCONFIG_USB_LED_TRIG=yCONFIG_USB=y# CONFIG_USB_PCI_AMD is not setCONFIG_USB_ANNOUNCE_NEW_DEVICES=yCONFIG_USB_DYNAMIC_MINORS=yCONFIG_USB_OTG=yCONFIG_USB_MON=yCONFIG_USB_XHCI_HCD=yCONFIG_USB_XHCI_DBGCAP=yCONFIG_USB_XHCI_PCI_RENESAS=yCONFIG_USB_EHCI_HCD=yCONFIG_USB_UHCI_HCD=yCONFIG_USB_STORAGE=yCONFIG_USB_UAS=yCONFIG_USB_DWC3=yCONFIG_USB_DWC3_DUAL_ROLE=yCONFIG_USB_DWC3_PCI=y# CONFIG_USB_DWC3_HAPS is not setCONFIG_USB_SERIAL=yCONFIG_USB_SERIAL_CONSOLE=yCONFIG_USB_SERIAL_GENERIC=yCONFIG_USB_SERIAL_SIMPLE=yCONFIG_USB_SERIAL_CH341=yCONFIG_USB_SERIAL_CP210X=yCONFIG_USB_GADGET=yCONFIG_U_SERIAL_CONSOLE=yCONFIG_USB_CONFIGFS=yCONFIG_USB_CONFIGFS_SERIAL=yCONFIG_USB_CONFIGFS_ACM=yCONFIG_USB_CONFIGFS_NCM=yCONFIG_USB_CONFIGFS_ECM=yCONFIG_USB_CONFIGFS_RNDIS=yCONFIG_USB_CONFIGFS_EEM=yCONFIG_USB_CONFIGFS_MASS_STORAGE=yCONFIG_USB_CONFIGFS_F_FS=yCONFIG_USB_CONFIGFS_F_UAC2=yCONFIG_USB_CONFIGFS_F_HID=yCONFIG_USB_CONFIGFS_F_UVC=yCONFIG_USB_ROLES_INTEL_XHCI=yCONFIG_MMC=yCONFIG_MMC_CRYPTO=yCONFIG_MMC_SDHCI=yCONFIG_MMC_SDHCI_ACPI=yCONFIG_LEDS_CLASS_MULTICOLOR=yCONFIG_LEDS_BRIGHTNESS_HW_CHANGED=yCONFIG_LEDS_KTD202X=yCONFIG_LEDS_TRIGGER_DISK=yCONFIG_LEDS_TRIGGER_CPU=yCONFIG_LEDS_TRIGGER_PANIC=yCONFIG_LEDS_TRIGGER_INPUT_EVENTS=yCONFIG_ACCESSIBILITY=yCONFIG_EDAC=y# CONFIG_EDAC_LEGACY_SYSFS is not setCONFIG_EDAC_GHES=yCONFIG_RTC_CLASS=yCONFIG_DMADEVICES=yCONFIG_DW_DMAC=yCONFIG_INTEL_LDMA=yCONFIG_ASYNC_TX_DMA=yCONFIG_SW_SYNC=yCONFIG_UDMABUF=yCONFIG_DMABUF_HEAPS=yCONFIG_DMABUF_HEAPS_SYSTEM=y# CONFIG_VIRTIO_MENU is not setCONFIG_STAGING=yCONFIG_AD5933=yCONFIG_STAGING_MEDIA=yCONFIG_INTEL_ATOMISP=yCONFIG_VIDEO_ATOMISP=m# CONFIG_SURFACE_PLATFORMS is not set# CONFIG_WMI_BMOF is not setCONFIG_INTEL_HID_EVENT=yCONFIG_INTEL_INT0002_VGPIO=yCONFIG_INTEL_TURBO_MAX_3=yCONFIG_X86_ANDROID_TABLETS=yCONFIG_INTEL_SCU_PCI=yCONFIG_HWSPINLOCK=yCONFIG_INTEL_IOMMU=yCONFIG_INTEL_IOMMU_SVM=y# CONFIG_INTEL_IOMMU_DEFAULT_ON is not set# CONFIG_INTEL_IOMMU_SCALABLE_MODE_DEFAULT_ON is not setCONFIG_IRQ_REMAP=yCONFIG_VIRTIO_IOMMU=yCONFIG_REMOTEPROC=yCONFIG_REMOTEPROC_CDEV=yCONFIG_PM_DEVFREQ=yCONFIG_DEVFREQ_GOV_SIMPLE_ONDEMAND=yCONFIG_DEVFREQ_GOV_PERFORMANCE=yCONFIG_DEVFREQ_GOV_POWERSAVE=yCONFIG_DEVFREQ_GOV_USERSPACE=yCONFIG_DEVFREQ_GOV_PASSIVE=yCONFIG_PM_DEVFREQ_EVENT=yCONFIG_EXTCON_INTEL_INT3496=yCONFIG_EXTCON_INTEL_CHT_WC=yCONFIG_MEMORY=yCONFIG_IIO=yCONFIG_HID_SENSOR_ACCEL_3D=yCONFIG_HID_SENSOR_GYRO_3D=yCONFIG_HID_SENSOR_ALS=yCONFIG_HID_SENSOR_MAGNETOMETER_3D=yCONFIG_HID_SENSOR_INCLINOMETER_3D=yCONFIG_HID_SENSOR_DEVICE_ROTATION=yCONFIG_PWM=yCONFIG_PWM_CRC=yCONFIG_PWM_LPSS_PCI=yCONFIG_PWM_LPSS_PLATFORM=yCONFIG_RESET_CONTROLLER=yCONFIG_RESET_SIMPLE=yCONFIG_GENERIC_PHY=yCONFIG_INTEL_RAPL=yCONFIG_RAS_CEC=yCONFIG_ANDROID_BINDER_IPC=yCONFIG_ANDROID_BINDERFS=yCONFIG_ANDROID_BINDER_IPC_SELFTEST=y# CONFIG_BLK_DEV_PMEM is not setCONFIG_INTERCONNECT=yCONFIG_HTE=yCONFIG_VALIDATE_FS_PARSER=yCONFIG_EXT4_FS=yCONFIG_EXT4_FS_POSIX_ACL=yCONFIG_EXT4_FS_SECURITY=yCONFIG_BTRFS_FS=yCONFIG_BTRFS_FS_POSIX_ACL=yCONFIG_FS_DAX=yCONFIG_EXPORTFS_BLOCK_OPS=yCONFIG_FS_ENCRYPTION=yCONFIG_FS_ENCRYPTION_INLINE_CRYPT=yCONFIG_FS_VERITY=yCONFIG_FS_VERITY_BUILTIN_SIGNATURES=yCONFIG_FANOTIFY=yCONFIG_FANOTIFY_ACCESS_PERMISSIONS=yCONFIG_QUOTA=yCONFIG_QUOTA_NETLINK_INTERFACE=yCONFIG_FUSE_FS=yCONFIG_AUTOFS_FS=mCONFIG_VFAT_FS=yCONFIG_PROC_KCORE=yCONFIG_PROC_VMCORE_DEVICE_DUMP=yCONFIG_TMPFS_POSIX_ACL=yCONFIG_TMPFS_INODE64=yCONFIG_HUGETLBFS=yCONFIG_EFIVAR_FS=yCONFIG_ECRYPT_FS=yCONFIG_ECRYPT_FS_MESSAGING=yCONFIG_SQUASHFS=yCONFIG_SQUASHFS_FILE_DIRECT=yCONFIG_SQUASHFS_XATTR=yCONFIG_SQUASHFS_LZ4=yCONFIG_SQUASHFS_LZO=yCONFIG_SQUASHFS_XZ=yCONFIG_SQUASHFS_ZSTD=yCONFIG_NLS_DEFAULT="utf8"CONFIG_NLS_CODEPAGE_437=yCONFIG_NLS_ASCII=yCONFIG_NLS_ISO8859_1=yCONFIG_NLS_UTF8=yCONFIG_UNICODE=yCONFIG_KEYS_REQUEST_CACHE=yCONFIG_PERSISTENT_KEYRINGS=yCONFIG_TRUSTED_KEYS=yCONFIG_USER_DECRYPTED_DATA=yCONFIG_KEY_DH_OPERATIONS=yCONFIG_KEY_NOTIFICATIONS=yCONFIG_SECURITY_DMESG_RESTRICT=yCONFIG_SECURITY=yCONFIG_INTEL_TXT=yCONFIG_LSM_MMAP_MIN_ADDR=0CONFIG_HARDENED_USERCOPY=yCONFIG_FORTIFY_SOURCE=yCONFIG_SECURITY_SELINUX=yCONFIG_SECURITY_SELINUX_BOOTPARAM=yCONFIG_SECURITY_SMACK=yCONFIG_SECURITY_SMACK_NETFILTER=yCONFIG_SECURITY_SMACK_APPEND_SIGNALS=yCONFIG_SECURITY_TOMOYO=yCONFIG_SECURITY_APPARMOR=yCONFIG_SECURITY_YAMA=yCONFIG_SECURITY_SAFESETID=yCONFIG_SECURITY_LOCKDOWN_LSM=yCONFIG_SECURITY_LOCKDOWN_LSM_EARLY=yCONFIG_SECURITY_LANDLOCK=yCONFIG_INTEGRITY_SIGNATURE=yCONFIG_INTEGRITY_ASYMMETRIC_KEYS=yCONFIG_INTEGRITY_PLATFORM_KEYRING=yCONFIG_INTEGRITY_MACHINE_KEYRING=yCONFIG_IMA=yCONFIG_IMA_KEXEC=yCONFIG_IMA_APPRAISE=yCONFIG_IMA_ARCH_POLICY=yCONFIG_IMA_APPRAISE_MODSIG=yCONFIG_EVM=yCONFIG_EVM_EXTRA_SMACK_XATTRS=yCONFIG_EVM_ADD_XATTRS=yCONFIG_DEFAULT_SECURITY_APPARMOR=yCONFIG_LSM="landlock,lockdown,yama,integrity,apparmor"CONFIG_INIT_STACK_NONE=yCONFIG_INIT_ON_ALLOC_DEFAULT_ON=yCONFIG_ZERO_CALL_USED_REGS=yCONFIG_CRYPTO_DH_RFC7919_GROUPS=yCONFIG_CRYPTO_HCTR2=yCONFIG_CRYPTO_SEQIV=yCONFIG_CRYPTO_DEFLATE=yCONFIG_CRYPTO_842=yCONFIG_CRYPTO_LZ4=yCONFIG_CRYPTO_LZ4HC=yCONFIG_CRYPTO_ZSTD=yCONFIG_CRYPTO_DRBG_HASH=yCONFIG_CRYPTO_DRBG_CTR=yCONFIG_CRYPTO_USER_API_HASH=yCONFIG_CRYPTO_USER_API_SKCIPHER=yCONFIG_CRYPTO_USER=m# CONFIG_CRYPTO_USER_API_ENABLE_OBSOLETE is not setCONFIG_CRYPTO_AES_NI_INTEL=yCONFIG_CRYPTO_CHACHA20_X86_64=yCONFIG_CRYPTO_BLAKE2S_X86=yCONFIG_CRYPTO_POLY1305_X86_64=yCONFIG_CRYPTO_SHA1_SSSE3=yCONFIG_CRYPTO_SHA256_SSSE3=yCONFIG_CRYPTO_SHA512_SSSE3=yCONFIG_CRYPTO_GHASH_CLMUL_NI_INTEL=yCONFIG_CRYPTO_DEV_PADLOCK=yCONFIG_CRYPTO_DEV_CCP=yCONFIG_SIGNED_PE_FILE_VERIFICATION=yCONFIG_SYSTEM_EXTRA_CERTIFICATE=yCONFIG_SECONDARY_TRUSTED_KEYRING=yCONFIG_SYSTEM_BLACKLIST_KEYRING=yCONFIG_SYSTEM_REVOCATION_LIST=yCONFIG_PACKING=yCONFIG_CRYPTO_LIB_CURVE25519=yCONFIG_CRYPTO_LIB_CHACHA20POLY1305=y# CONFIG_XZ_DEC_POWERPC is not set# CONFIG_XZ_DEC_ARM64 is not set# CONFIG_XZ_DEC_RISCV is not setCONFIG_XZ_DEC_MICROLZMA=yCONFIG_IRQ_POLL=yCONFIG_FONTS=yCONFIG_FONT_8x8=yCONFIG_FONT_8x16=yCONFIG_FONT_ACORN_8x8=yCONFIG_FONT_6x10=yCONFIG_FONT_TER16x32=yCONFIG_PRINTK_TIME=yCONFIG_BOOT_PRINTK_DELAY=yCONFIG_DYNAMIC_DEBUG=yCONFIG_DEBUG_INFO_DWARF5=yCONFIG_GDB_SCRIPTS=yCONFIG_FRAME_WARN=1024CONFIG_STACK_VALIDATION=yCONFIG_VMLINUX_MAP=yCONFIG_MAGIC_SYSRQ_DEFAULT_ENABLE=0x01b6CONFIG_KGDB=yCONFIG_KGDB_LOW_LEVEL_TRAP=yCONFIG_KGDB_KDB=yCONFIG_KDB_KEYBOARD=yCONFIG_UBSAN=yCONFIG_UBSAN_SHIFT=yCONFIG_PAGE_POISONING=yCONFIG_DEBUG_WX=yCONFIG_SCHED_STACK_END_CHECK=yCONFIG_KFENCE=yCONFIG_KFENCE_SAMPLE_INTERVAL=0CONFIG_HARDLOCKUP_DETECTOR=yCONFIG_SCHEDSTATS=yCONFIG_RCU_CPU_STALL_TIMEOUT=60# CONFIG_RCU_TRACE is not setCONFIG_BOOTTIME_TRACING=yCONFIG_FPROBE=yCONFIG_FUNCTION_PROFILER=yCONFIG_STACK_TRACER=yCONFIG_SCHED_TRACER=yCONFIG_HWLAT_TRACER=yCONFIG_MMIOTRACE=yCONFIG_FTRACE_SYSCALLS=yCONFIG_BLK_DEV_IO_TRACE=yCONFIG_BPF_KPROBE_OVERRIDE=yCONFIG_HIST_TRIGGERS=yCONFIG_TRACE_EVENT_INJECT=yCONFIG_RV=yCONFIG_RV_MON_WWNR=yCONFIG_SAMPLES=y# CONFIG_X86_VERBOSE_BOOTUP is not setCONFIG_EARLY_PRINTK_DBGP=yCONFIG_EARLY_PRINTK_USB_XDBC=yCONFIG_IO_DELAY_0XED=yCONFIG_PUNIT_ATOM_DEBUG=yCONFIG_UNWINDER_FRAME_POINTER=yCONFIG_FUNCTION_ERROR_INJECTION=yCONFIG_MEMTEST=y# CachyOS-derived Mi Pad 2 profile (Cherry Trail/Airmont, 2 GiB RAM).CONFIG_LOCALVERSION="-mipad2-cachyos"# CONFIG_LOCALVERSION_AUTO is not set# CONFIG_MATOM is not setCONFIG_MSILVERMONT=y# CONFIG_CC_OPTIMIZE_FOR_PERFORMANCE is not setCONFIG_CC_OPTIMIZE_FOR_PERFORMANCE_O3=yCONFIG_PREEMPT_BUILD=yCONFIG_PREEMPT=yCONFIG_PREEMPT_DYNAMIC=yCONFIG_SCHED_BORE=yCONFIG_SCHED_AUTOGROUP=y# CONFIG_HZ_100 is not set# CONFIG_HZ_250 is not setCONFIG_HZ_300=y# CONFIG_HZ_500 is not set# CONFIG_HZ_600 is not set# CONFIG_HZ_750 is not set# CONFIG_HZ_1000 is not setCONFIG_HZ=300CONFIG_NO_HZ_IDLE=y# CONFIG_NO_HZ_FULL is not setCONFIG_MQ_IOSCHED_DEADLINE=yCONFIG_MQ_IOSCHED_ADIOS=yCONFIG_IOSCHED_BFQ=yCONFIG_BFQ_GROUP_IOSCHED=yCONFIG_LRU_GEN=yCONFIG_LRU_GEN_ENABLED=yCONFIG_TRANSPARENT_HUGEPAGE=yCONFIG_TRANSPARENT_HUGEPAGE_MADVISE=y# CONFIG_TRANSPARENT_HUGEPAGE_ALWAYS is not setCONFIG_ZRAM=yCONFIG_ZRAM_BACKEND_LZ4=yCONFIG_ZRAM_BACKEND_ZSTD=yCONFIG_ZRAM_DEF_COMP_ZSTD=yCONFIG_ZRAM_WRITEBACK=yCONFIG_ZRAM_MEMORY_TRACKING=yCONFIG_LTO_CLANG_THIN=yCONFIG_MODULE_COMPRESS=yCONFIG_MODULE_COMPRESS_ZSTD=yCONFIG_MODULE_DECOMPRESS=yCONFIG_CPU_FREQ=yCONFIG_CPU_FREQ_DEFAULT_GOV_SCHEDUTIL=yCONFIG_CPU_FREQ_GOV_SCHEDUTIL=yCONFIG_X86_INTEL_PSTATE=y
```
